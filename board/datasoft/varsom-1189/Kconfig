## board/datasoft/varsom-1189/Kconfig
```kconfig
if TARGET_VARSOM_1189

config SYS_BOARD
	default "varsom-1189"

config SYS_VENDOR
	default "datasoft"

config SYS_CONFIG_NAME
	default "varsom-1189"

endif
```

## board/datasoft/varsom-1233/Kconfig
```kconfig
if TARGET_VARSOM_1233

config SYS_BOARD
	default "varsom-1233"

config SYS_VENDOR
	default "datasoft"

config SYS_CONFIG_NAME
	default "varsom-1233"

endif
```

## board/datasoft/varsom-1338/Kconfig
```kconfig
if TARGET_VARSOM_1338

config SYS_BOARD
	default "varsom-1338"

config SYS_VENDOR
	default "datasoft"

config SYS_CONFIG_NAME
	default "varsom-1338"

endif
```

## board/datasoft/varsom-1341/Kconfig
```kconfig
if TARGET_VARSOM_1341

config SYS_BOARD
	default "varsom-1341"

config SYS_VENDOR
	default "datasoft"

config SYS_CONFIG_NAME
	default "varsom-1341"

endif
```

## board/datasoft/varsom-1348/Kconfig
```kconfig
if TARGET_VARSOM_1348

config SYS_BOARD
	default "varsom-1348"

config SYS_VENDOR
	default "datasoft"

config SYS_CONFIG_NAME
	default "varsom-1348"

endif
```
